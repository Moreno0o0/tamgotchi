#include <SPI.h>
#include <Adafruit_GFX.h>
#include <Adafruit_SSD1306.h>

#define SCREEN_WIDTH 128
#define SCREEN_HEIGHT 64

// Pines SPI para el ESP32-C6
#define OLED_MOSI  7
#define OLED_CLK   6
#define OLED_DC    4
#define OLED_CS    16
#define OLED_RESET 5

// --- PINES DE LOS BOTONES (Puedes ajustarlos a los que uses) ---
#define BTN_VERDURAS 8
#define BTN_DULCES   9
#define BTN_VACUNAR  10
#define BTN_JUGAR    1

// --- VARIABLES DEL JUEGO ---
int dia = 0;
int salud = 80;    // Rango de 0 a 100
int alegria = 50;  // Rango de 0 a 100
int amor = 75;     // Rango de 0 a 100
bool esta_vivo = true;

// Control de tiempo para que pasen los días
unsigned long tiempoAnterior = 0;
const long duracionDia = 10000; // 10 segundos reales = 1 día en el juego

// Estados de ánimo del Pumagotchi
enum Emocion { FELIZ, ENOJADO, MIEDO, ORGULLO, VERGUENZA, MUERTO };
Emocion emocionActual = FELIZ;

Adafruit_SSD1306 display(SCREEN_WIDTH, SCREEN_HEIGHT, OLED_MOSI, OLED_CLK, OLED_DC, OLED_RESET, OLED_CS);

// =========================================================================
// DEFINICIÓN DE CARAS (Byte Arrays en la memoria PROGMEM 64x43)
// =========================================================================
//muerto 58 x 39
//feliz  64 x 39
//enojado 39 x 39
//miedo 58 x39 

const unsigned char PROGMEM feliz []  = {
  0x00, 0x00, 0x00, 0x00, 0x00, 0x00, 0x00, 0x00, 0x0f, 0xfc, 0x00, 0x00, 0x00, 0x00, 0x7f, 0xf0, 
  0x0f, 0xfc, 0x00, 0x00, 0x00, 0x00, 0x7f, 0xf0, 0x0f, 0xfc, 0x00, 0x00, 0x00, 0x00, 0x7f, 0xe0, 
  0x70, 0x01, 0xc0, 0x00, 0x00, 0x03, 0x80, 0x0e, 0x70, 0x01, 0xc0, 0x00, 0x00, 0x03, 0x80, 0x0e, 
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  0x00, 0x00, 0x00, 0x00, 0x00, 0x00, 0x00, 0x00};


const unsigned char PROGMEM enojado []  = {
  0x00, 0x00, 0x00, 0x00, 0x00, 0x00, 0xe0, 0x00, 0x00, 0x00, 0x01, 0xe0, 0x00, 0x00, 0x00, 0x00, 
	0xf0, 0x00, 0x00, 0x00, 0x00, 0x70, 0x00, 0x00, 0x00, 0x00, 0x78, 0x00, 0x00, 0x00, 0x00, 0x38, 
	0x00, 0x00, 0x00, 0x00, 0x18, 0x00, 0x00, 0x00, 0x00, 0x1c, 0x00, 0x00, 0x00, 0x00, 0x04, 0x00, 
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	0x00, 0x00, 0x00};
const unsigned char PROGMEM miedo []  = { 
	0x00, 0x00, 0x00, 0x00, 0x00, 0x00, 0x00, 0x00, 0x0f, 0xf8, 0x00, 0x00, 0x00, 0x07, 0xfc, 0x00, 
	0x0f, 0xf8, 0x00, 0x00, 0x00, 0x07, 0xfc, 0x00, 0x0f, 0xf8, 0x00, 0x00, 0x00, 0x07, 0xfc, 0x00, 
	0x60, 0x07, 0x00, 0x00, 0x00, 0x38, 0x03, 0x80, 0xe0, 0x07, 0x00, 0x00, 0x00, 0x38, 0x03, 0x80, 
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	0x00, 0x00, 0x00, 0x00, 0x00, 0x00, 0x00, 0x00};

const unsigned char PROGMEM muerto []  = { 
  0x00, 0x00, 0x00, 0x00, 0x00, 0x00, 0x00, 0x00, 0x03, 0xf8, 0x00, 0x00, 0x00, 0x07, 0xfc, 0x00, 
	0x1f, 0xf8, 0x00, 0x00, 0x00, 0x07, 0xfe, 0x00, 0x3f, 0xfc, 0x00, 0x00, 0x00, 0x0f, 0xff, 0x00, 
	0x70, 0x07, 0x00, 0x00, 0x00, 0x78, 0x03, 0x00, 0x60, 0x07, 0x00, 0x00, 0x00, 0x78, 0x03, 0x00, 
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	0x00, 0x00, 0x00, 0x00, 0x00, 0x00, 0x00, 0x00
};

// =========================================================================

void setup() {
  Serial.begin(115200);

  // Configurar botones con resistencia Pull-Up interna
  pinMode(BTN_VERDURAS, INPUT_PULLUP);
  pinMode(BTN_DULCES, INPUT_PULLUP);
  pinMode(BTN_VACUNAR, INPUT_PULLUP);
  pinMode(BTN_JUGAR, INPUT_PULLUP);

  if(!display.begin(SSD1306_SWITCHCAPVCC)) {
    Serial.println(F("SSD1306 allocation failed"));
    for(;;); 
  }

  // Inicializamos generador de números aleatorios (para el minijuego)
  randomSeed(analogRead(0));

  display.clearDisplay();
  display.display();
}

void loop() {
  if (esta_vivo) {
    verificarBotones();
    verificarPasoDelTiempo();
    verificarLimitesVariables();
  }

  actualizarPantalla();
  delay(100); // Pequeña pausa para no saturar el procesador
}

// --- LOGICA DE MODELOS MENTALES ---

void verificarBotones() {
  // Los botones están en LOW cuando se presionan (por el PULLUP)
  
  if (digitalRead(BTN_VERDURAS) == LOW) {
    // Modelo Mental: Alimentar con verduras 
    emocionActual = ENOJADO;
    salud += 15;      // Gana salud
    alegria -= 10;    // Pierde felicidad
    delay(300);       // Antirrebote
  }
  else if (digitalRead(BTN_DULCES) == LOW) {
    // Modelo Mental: Alimentar con dulces 
    emocionActual = FELIZ;
    alegria += 15;    // Gana felicidad
    salud -= 10;      // Pierde salud
    delay(300);
  }
  else if (digitalRead(BTN_VACUNAR) == LOW) {
    // Modelo Mental: Vacunar 
    emocionActual = MIEDO;
    salud += 20;      // Gana mucha salud
    alegria -= 15;    // Pierde felicidad por el miedo
    delay(300);
  }
  else if (digitalRead(BTN_JUGAR) == LOW) {
    // Modelo Mental: Jugar con el dueño [cite: 277-287]
    amor += 15; // Siempre gana amor al interactuar
    
    // Simular que el Pumagotchi gana o pierde el juego (50% de probabilidad)
    if (random(0, 2) == 1) {
      emocionActual = ORGULLO;
      alegria += 15; // Gana felicidad al ganar
    } else {
      emocionActual = VERGUENZA;
      alegria -= 10; // Pierde felicidad al perder
    }
    delay(300);
  }
}

void verificarPasoDelTiempo() {
  unsigned long tiempoActual = millis();
  
  // Si ha pasado el tiempo equivalente a "un día"
  if (tiempoActual - tiempoAnterior >= duracionDia) {
    tiempoAnterior = tiempoActual;
    dia++;

    // Modelo Mental de final del día 
    // Si pasa un día, pierde estadísticas (simula desgaste natural)
    salud -= 5;
    alegria -= 5;
    amor -= 5;
    
    emocionActual = FELIZ; // Vuelve a neutral
  }
}

void verificarLimitesVariables() {
  // Mantener las variables entre 0 y 100
  if (salud > 100) salud = 100;
  if (alegria > 100) alegria = 100;
  if (amor > 100) amor = 100;

  // Modelo Mental: Comprobar estado de vida 
  if (salud <= 0 || alegria <= 0 || amor <= 0) {
    esta_vivo = false;
    emocionActual = MUERTO;
    salud = 0; alegria = 0; amor = 0;
  }
}

// --- LOGICA DE INTERFAZ GRAFICA ---

void actualizarPantalla() {
  display.clearDisplay();

  // 1. Título superior y Día
  display.setTextSize(1);
  display.setTextColor(SSD1306_WHITE);
  display.setCursor(0, 0);
  
  if (esta_vivo) {
    display.print("PUMAGOTCHI");
  } else {
    display.print("Q.E.P.D."); // Descanse en paz
  }

  display.setCursor(85, 0);
  display.print("DIA:");
  display.print(dia);

  // Línea separadora
  display.drawLine(0, 10, 128, 10, SSD1306_WHITE);

  // 2. Dibujar Cara dependiendo de la emoción actual
  // Cuando tengas las demás caras, cambia 'feliz' por el nombre del arreglo
  if (emocionActual == FELIZ) {
    display.drawBitmap(0, 15, feliz, 64, 43, SSD1306_WHITE);
  } else if (emocionActual == ENOJADO) {
    display.drawBitmap(0, 15, enojado, 64, 43, SSD1306_WHITE); // CAMBIAR por: enojado
  } else if (emocionActual == MIEDO) {
    display.drawBitmap(0, 15, miedo, 64, 43, SSD1306_WHITE); // CAMBIAR por: miedo
  } else if (emocionActual == MUERTO) {
    display.drawBitmap(0, 15, muerto, 64, 43, SSD1306_WHITE); // CAMBIAR por: muerto
  } else {
    // Para orgullo y vergüenza usamos la feliz por defecto por ahora
    display.drawBitmap(0, 15, feliz, 64, 43, SSD1306_WHITE); 
  }

  // 3. Dibujar Barras de Estado
  display.setTextSize(1);
  display.cp437(true); 

  display.setCursor(69, 33);
  display.write(1);    // Carita feliz
  display.setCursor(69, 48);
  display.write(3);    // Corazón 

  dibujarBarra(64, 18, " +", salud);
  dibujarBarra(64, 33, "", alegria);
  dibujarBarra(64, 48, "", amor);

  display.display();
}

void dibujarBarra(int x, int y, String etiqueta, int valor) {
  display.setCursor(x, y);
  display.print(etiqueta);

  int barraX = x + 15;
  display.drawRect(barraX, y, 40, 7, SSD1306_WHITE);

  int anchoRelleno = map(valor, 0, 100, 0, 36);
  display.fillRect(barraX + 2, y + 2, anchoRelleno, 3, SSD1306_WHITE);
}